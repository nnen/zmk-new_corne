## boards/shields/eyelash_corne/Kconfig.shield
```kconfig
# Copyright (c) 2020 The ZMK Contributors
# SPDX-License-Identifier: MIT

config SHIELD_EYELASH_CORNE_CENTRAL_DONGLE
    def_bool $(shields_list_contains,eyelash_corne_central_dongle)

config SHIELD_EYELASH_CORNE_PERIPHERAL_LEFT
    def_bool $(shields_list_contains,eyelash_corne_peripheral_left)

config SHIELD_EYELASH_CORNE_PERIPHERAL_RIGHT
    def_bool $(shields_list_contains,eyelash_corne_peripheral_right)
```
